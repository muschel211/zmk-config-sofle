## config/west.yml
```yaml
manifest:
  remotes:
    - name: zmkfirmware
      url-base: https://github.com/zmkfirmware
    - name: muschel211
      url-base: https://github.com/muschel211
  projects:
    - name: zmk
      remote: muschel211
      revision: sofle
      import: app/west.yml
  self:
    path: config
```
